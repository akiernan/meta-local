## conf/machine/include/rk3308.inc
```bitbake
SOC_FAMILY = "rk3308"

DEFAULTTUNE ?= "cortexa35-crypto"

require conf/machine/include/soc-family.inc
require conf/machine/include/tune-cortexa35.inc
require conf/machine/include/rockchip-defaults.inc

SERIAL_CONSOLES = "1500000;ttyS0"

AVAILTUNES += "cortexa35-32 cortexa35-32-crypto"
ARMPKGARCH:tune-cortexa35-32             = "cortexa35-32"
ARMPKGARCH:tune-cortexa35-32-crypto      = "cortexa35-32-crypto"
TUNE_FEATURES:tune-cortexa35-32          = "armv8a crc cortexa35 callconvention-hard neon"
TUNE_FEATURES:tune-cortexa35-32-crypto   = "${TUNE_FEATURES:tune-cortexa35-32} crypto"
PACKAGE_EXTRA_ARCHS:tune-cortexa35-32             = "${PACKAGE_EXTRA_ARCHS:tune-armv8a-crc} cortexa35-32 cortexa35-32hf-neon"
PACKAGE_EXTRA_ARCHS:tune-cortexa35-32-crypto      = "${PACKAGE_EXTRA_ARCHS:tune-armv8a-crc-crypto} cortexa35-32 cortexa35-32-cryptohf-neon"

BASE_LIB:tune-cortexa35-32               = "lib"
BASE_LIB:tune-cortexa35-32-crypto        = "lib"
```

## conf/machine/qemuarm-cortex-a35-32.conf
```bitbake
#@TYPE: Machine
#@NAME: QEMU Arm Cortex-A15 machine
#@DESCRIPTION: Machine configuration for running an ARMv7 system on QEMU

DEFAULTTUNE = "cortexa35-32-crypto"
SERIAL_CONSOLES ?= "115200;ttyAMA0"

require conf/machine/include/arm/armv8a/tune-cortexa35.inc
require conf/machine/include/qemu.inc

AVAILTUNES += "cortexa35-32 cortexa35-32-crypto"
ARMPKGARCH:tune-cortexa35-32             = "cortexa35-32"
ARMPKGARCH:tune-cortexa35-32-crypto      = "cortexa35-32-crypto"
TUNE_FEATURES:tune-cortexa35-32          = "armv8a crc cortexa35 callconvention-hard neon"
TUNE_FEATURES:tune-cortexa35-32-crypto   = "${TUNE_FEATURES:tune-cortexa35-32} crypto"
PACKAGE_EXTRA_ARCHS:tune-cortexa35-32             = "${PACKAGE_EXTRA_ARCHS:tune-armv8a-crc} cortexa35-32 cortexa35-32hf-neon"
PACKAGE_EXTRA_ARCHS:tune-cortexa35-32-crypto      = "${PACKAGE_EXTRA_ARCHS:tune-armv8a-crc-crypto} cortexa35-32 cortexa35-32-cryptohf-neon"

BASE_LIB:tune-cortexa35-32               = "lib"
BASE_LIB:tune-cortexa35-32-crypto        = "lib"

KERNEL_IMAGETYPE = "zImage"

PREFERRED_PROVIDER_virtual/bootloader ?= "u-boot"
UBOOT_MACHINE ?= "qemu_arm_defconfig"

# For runqemu
QB_SYSTEM_NAME = "qemu-system-aarch64"
QB_MACHINE = "-machine virt"
QB_CPU = "-cpu cortex-a35,aarch64=off"
QB_SMP ?= "-smp 4"
QB_CPU_KVM = "-cpu host -machine gic-version=3"
# For graphics to work we need to define the VGA device as well as the necessary USB devices
QB_GRAPHICS = "-device virtio-gpu-pci"
QB_OPT_APPEND = "-device qemu-xhci -device usb-tablet -device usb-kbd"
# Virtio Networking support
QB_TAP_OPT = "-netdev tap,id=net0,ifname=@TAP@,script=no,downscript=no"
QB_NETWORK_DEVICE = "-device virtio-net-pci,netdev=net0,mac=@MAC@"
# Virtio block device
QB_ROOTFS_OPT = "-drive id=disk0,file=@ROOTFS@,if=none,format=raw -device virtio-blk-pci,drive=disk0"
# Virtio serial console
QB_SERIAL_OPT = "-device virtio-serial-pci -chardev null,id=virtcon -device virtconsole,chardev=virtcon"
QB_TCPSERIAL_OPT = "-device virtio-serial-pci -chardev socket,id=virtcon,port=@PORT@,host=127.0.0.1,nodelay=on -device virtconsole,chardev=virtcon"
```

## conf/machine/rithum-switch-32.conf
```bitbake
#@TYPE: Machine
#@NAME: Rithum Switch (aarch32)
#@DESCRIPTION: Rithum Switch is a Rockchip RK3308 based touch panel.
#https://rithumhome.com/product/rithum-switch

DEFAULTTUNE ?= "cortexa35-32-crypto"

require conf/machine/include/rk3308.inc
```

## conf/machine/rithum-switch.conf
```bitbake
#@TYPE: Machine
#@NAME: Rithum Switch
#@DESCRIPTION: Rithum Switch is a Rockchip RK3308 based touch panel.
#https://rithumhome.com/product/rithum-switch

require conf/machine/include/rk3308.inc
```
